## Kconfig
```kconfig
menu "TDN Battery (NiMH) Driver"
config TDN_BATTERY_NIMH_DIVIDER
    bool "Enable NiMH battery divider driver"
    select ADC
    select SENSOR
    help
      ADCで電圧を読み、NiMH向けのSoC算出を行う独自ドライバ。
endmenu
```

## dts/bindings/sensor/naka,battery-nimh-divider.yaml
```yaml
j# SPDX-License-Identifier: MIT
title: TDN NiMH Battery Voltage Divider
description: ADC + voltage divider battery sensor with NiMH SoC mapping
compatible: "naka,battery-nimh-divider"

include: [adc-channel.yaml]

properties:
  output-ohms:
    type: int
    required: true
    description: Resistor to ground in ohms (R2)
  full-ohms:
    type: int
    required: true
    description: R1 + R2 in ohms (top + bottom)
  power-gpios:
    type: phandle-array
    required: false
    description: Optional GPIO to power the divider
```

## dts/bindings/sensor/zmk,battery-custom.yaml
```yaml
# Copyright (c) 2020 The ZMK Contributors
# SPDX-License-Identifier: MIT

description: Battery SoC monitoring using voltage divider

compatible: "zmk,battery_custom.c"

include: voltage-divider.yaml
```
